## config/boards/Kconfig.shield
```kconfig
config SHIELD_CARD_NORM_LEFT
	def_bool $(shields_list_contains,card_norm_left)

config SHIELD_CARD_NORM_RIGHT
	def_bool $(shields_list_contains,card_norm_right)
```
